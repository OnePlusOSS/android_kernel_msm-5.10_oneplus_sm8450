## drivers/misc/cs_press/Kconfig
```kconfig
config CSA37F71_SENSOR_NDT
	tristate "Awinic CSA37F71 Sensor driver"
	depends on I2C
	help
		Say Y here if you have Awinic CSA37F71 sensor controller
		chip in your system.
		If unsure, say N.
		To compile this driver as a module, choose M here: the
		module will be called CSA37F71.
```

## drivers/soc/Kconfig
```kconfig
# SPDX-License-Identifier: GPL-2.0-only
menu "SOC (System On Chip) specific Drivers"

source "drivers/soc/actions/Kconfig"
source "drivers/soc/amlogic/Kconfig"
source "drivers/soc/aspeed/Kconfig"
source "drivers/soc/atmel/Kconfig"
source "drivers/soc/bcm/Kconfig"
source "drivers/soc/fsl/Kconfig"
source "drivers/soc/imx/Kconfig"
source "drivers/soc/ixp4xx/Kconfig"
source "drivers/soc/mediatek/Kconfig"
source "drivers/soc/qcom/Kconfig"
source "drivers/soc/renesas/Kconfig"
source "drivers/soc/rockchip/Kconfig"
source "drivers/soc/samsung/Kconfig"
source "drivers/soc/sifive/Kconfig"
source "drivers/soc/sunxi/Kconfig"
source "drivers/soc/tegra/Kconfig"
source "drivers/soc/ti/Kconfig"
source "drivers/soc/ux500/Kconfig"
source "drivers/soc/versatile/Kconfig"
source "drivers/soc/xilinx/Kconfig"
source "drivers/soc/zte/Kconfig"
source "drivers/soc/kendryte/Kconfig"

#ifdef OPLUS_FEATURE_SUGOV_POWER_EFFIENCY
source "drivers/soc/oplus/cpufreq_effiency/Kconfig"
#endif /* OPLUS_FEATURE_SUGOV_POWER_EFFIENCY */

#ifdef OPLUS_BUG_STABILITY
source "drivers/soc/oplus/system/Kconfig"
#endif /* OPLUS_BUG_STABILITY */

#ifdef OPLUS_FEATURE_TP_BASIC
source "drivers/soc/oplus/device_info/Kconfig"
#endif /* OPLUS_FEATURE_TP_BASIC */

#ifdef OPLUS_FEATURE_SENSOR_SMEM
source "drivers/soc/oplus/sensor/Kconfig"
#endif /* OPLUS_FEATURE_SENSOR_SMEM */

#ifdef OPLUS_FEATURE_OCH
source "drivers/soc/oplus/power/cpufreq_health/Kconfig"
#endif /* OPLUS_FEATURE_OCH */

#ifdef OPLUS_FEATURE_THERMAL_HORAE
source "drivers/soc/oplus/thermal/Kconfig"
#endif /* OPLUS_FEATURE_THERMAL_HORAE */

#ifdef OPLUS_FEATURE_RT_TRACE
source "drivers/soc/oplus/rt_info/Kconfig"
#endif /* OPLUS_FEATURE_RT_TRACE */

#ifdef OPLUS_FEATURE_MIDAS_GKI
source "drivers/soc/oplus/power/midas/Kconfig"
#endif

#ifdef OPLUS_FEATURE_OMRG
source "drivers/soc/oplus/thermal/oplus_omrg/Kconfig"
#endif /* OPLUS_FEATURE_OMRG */
endmenu
```

## drivers/staging/pseudo-sensor/Kconfig
```kconfig
# SPDX-License-Identifier: GPL-2.0
config PSEUDO_SENSOR
    tristate "Allow pseudo sensor debugging interface"
    default n
    help
      This module adds support pseudo sensor.
      Enable pseudo sensor debugging interface
      The driver creates a series of interfaces in the /proc for user mode
      The driver provides contiguous memory for SLPI use
```

## net/oplus_wificapcenter/Kconfig
```kconfig
# SPDX-License-Identifier: GPL-2.0-only
# Copyright (C) 2020-2022 Oplus. All rights reserved.
# XuFenghua@CONNECTIVITY.WIFI.BASIC.CAPCENTER.190453, OPLUS_FEATURE_WIFI_CAPCENTER
# XiaZijian@CONNECTIVITY.WIFI.P2P.26106,20210528, OPLUS_FEATURE_WIFI_OPLUSWFD

config OPLUS_FEATURE_WIFI_CAPCENTER
	tristate "Add for Oplus Wifi capability center"
	help
	  Add for Oplus Wifi capability center.

config OPLUS_FEATURE_WIFI_OPLUSWFD
	tristate "Add for OplusWFD"
	help
	  Add for Add for OplusWFD.
```
